## main/boards/doit-esp32s3-eye-8311/sdkconfig.defaults.board
```kconfig
CONFIG_BOARD_TYPE_DOIT_ESP32S3_EYE_8311=y

CONFIG_DISPLAY_LCD_TYPE=LCD_GC9A01_240X240
CONFIG_USE_EYE_STYLE_ES8311=y
CONFIG_USE_AFE_WAKE_WORD=y
CONFIG_USE_AUDIO_CODEC_ENCODE_OPUS=n

CONFIG_USE_AFE_WAKE_WORD=y
CONFIG_USE_AUDIO_PROCESSOR=n
```
